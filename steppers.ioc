# file: steppers.ioc
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Mcu.Family=STM32F0
Mcu.Name=STM32F072R(8-B)Tx
Mcu.Package=LQFP64
ProjectManager.HeapSize=0x200
ProjectManager.StackSize=0x400
ProjectManager.TargetToolchain=MDK-ARM V5
board=steppers

// file: Src/main.c
/**
  ******************************************************************************
  * File Name          : main.c
  * Description        : Main program body
  ******************************************************************************
  *
  * COPYRIGHT(c) 2017 STMicroelectronics
  *
  * Redistribution and use in source and binary forms, with or without modification,
  * are permitted provided that the following conditions are met:
  *   1. Redistributions of source code must retain the above copyright notice,
  *      this list of conditions and the following disclaimer.
  *   2. Redistributions in binary form must reproduce the above copyright notice,
  *      this list of conditions and the following disclaimer in the documentation
  *      and/or other materials provided with the distribution.
  *   3. Neither the name of STMicroelectronics nor the names of its contributors
  *      may be used to endorse or promote products derived from this software
  *      without specific prior written permission.
  *
  * THIS SOFTWARE IS PROVIDED BY THE COPYRIGHT HOLDERS AND CONTRIBUTORS "AS IS"
  * AND ANY EXPRESS OR IMPLIED WARRANTIES, INCLUDING, BUT NOT LIMITED TO, THE
  * IMPLIED WARRANTIES OF MERCHANTABILITY AND FITNESS FOR A PARTICULAR PURPOSE ARE
  * DISCLAIMED. IN NO EVENT SHALL THE COPYRIGHT HOLDER OR CONTRIBUTORS BE LIABLE
  * FOR ANY DIRECT, INDIRECT, INCIDENTAL, SPECIAL, EXEMPLARY, OR CONSEQUENTIAL
  * DAMAGES (INCLUDING, BUT NOT LIMITED TO, PROCUREMENT OF SUBSTITUTE GOODS OR
  * SERVICES; LOSS OF USE, DATA, OR PROFITS; OR BUSINESS INTERRUPTION) HOWEVER
  * CAUSED AND ON ANY THEORY OF LIABILITY, WHETHER IN CONTRACT, STRICT LIABILITY,
  * OR TORT (INCLUDING NEGLIGENCE OR OTHERWISE) ARISING IN ANY WAY OUT OF THE USE
  * OF THIS SOFTWARE, EVEN IF ADVISED OF THE POSSIBILITY OF SUCH DAMAGE.
  *
  ******************************************************************************
  */
#include "main.h"
#include "stm32f0xx_hal.h"

/* USER CODE BEGIN Includes */
#include "gpio.h"
#include "stepper.h"
#include "stepper_control.h"
#include "serial.h"
#include "string.h"
#include "hall_array_library.h"

#define STEP_PRIORITY 1
#define RX_TIMEOUT 1000 // ms
#define BUFF_SIZE 64

char rx_buffer[BUFF_SIZE];
int i = 0;

/* USER CODE END Includes */

/* USER CODE BEGIN PV */
/* Private variables ---------------------------------------------------------*/

/* USER CODE END PV */

void SystemClock_Config(void);
void Error_Handler(void);

/* USER CODE BEGIN PFP */
/* Private function prototypes -----------------------------------------------*/
#ifdef __GNUC__
  #define PUTCHAR_PROTOTYPE int __io_putchar(int ch)
#else
  #define PUTCHAR_PROTOTYPE int fputc(int ch, FILE *f)
#endif /* __GNUC__ */

// Retargets the C library printf function to the USART
PUTCHAR_PROTOTYPE {
	while(!(USART1->ISR & USART_ISR_TXE)) {
		// wait
	}
	USART1->TDR = ch;
	return ch;
}

char rx_char() {
	if (USART1->ISR & USART_ISR_RXNE) {
		return USART1->RDR;
	}
	return 0;
}

void wait_for_command(void) {
	uint32_t timeout = HAL_GetTick() + RX_TIMEOUT;
	int status = -1;
	char c = rx_char();
	if (!c) { // don't try unless a char has been received
		return;
	}
	CLEAR_BUFF(rx_buffer, BUFF_SIZE, i);
	while (HAL_GetTick() < timeout) {
		if (c) {
			if (DEBUG) printf(&c);
			status = rx_serial_command_r(c, rx_buffer, &i, BUFF_SIZE, NULL);
			if (status == FAIL) {
				SEND_CMD_P(CMD_STATUS, "%d", STATUS_FAIL);
				break;
			} else if (status != CONTINUE) {
				break;
			}
		}
		c = rx_char();
	}
	CLEAR_BUFF(rx_buffer, BUFF_SIZE, i);
	if (status == CONTINUE) {
		LOG_WARN("Timeout. Clearing buffer.");
		SEND_CMD_P(CMD_STATUS, "%d", STATUS_FAIL);
	}
}
/* USER CODE END PFP */

/* USER CODE BEGIN 0 */

/*
 *	initialize user button
 */
void  button_init(void) {
    // Initialize PA0 for button input
    RCC->AHBENR |= RCC_AHBENR_GPIOAEN;                                          // Enable peripheral clock to GPIOA
    GPIOA->MODER &= ~(GPIO_MODER_MODER0_0 | GPIO_MODER_MODER0_1);               // Set PA0 to input
    GPIOC->OSPEEDR &= ~(GPIO_OSPEEDR_OSPEEDR0_0 | GPIO_OSPEEDR_OSPEEDR0_1);     // Set to low speed
    GPIOC->PUPDR |= GPIO_PUPDR_PUPDR0_1;                                        // Set to pull-down
}

/*
 *	initialize PWM timers for step control
 */
void timer_init(void) {
	RCC->AHBENR  |= RCC_AHBENR_GPIOCEN;
	RCC->APB1ENR |= RCC_APB1ENR_TIM3EN; // PWM
	RCC->APB1ENR |= RCC_APB1ENR_TIM2EN; // for interrupts, mirror PWM

	// for interrupt
	TIM2->PSC   = PRESCALE;
	TIM2->ARR   = AUTO_RELOAD;
	TIM2->DIER |= TIM_DIER_UIE;

	// PWM waveforms for stepper driver DRV8824
	TIM3->PSC = PRESCALE;	// frequency = (8MHz/PSC/ARR) *approximatly*
	TIM3->ARR = AUTO_RELOAD;
	// duty cycle: CCR is % of ARR register (ex. ARR = 10, CCR = 1 => 10% duty cycle)
	TIM3->CCR3 = 0; // PC8
	TIM3->CCR4 = 0; // PC9
	TIM3->CCMR2 |= (6 << TIM_CCMR2_OC3M_Pos); // ch 3 capture/compare PWM mode 1
	TIM3->CCMR2 |= (6 << TIM_CCMR2_OC4M_Pos); // ch 4 capture/compare PWM mode 1
	TIM3->CCER  |= TIM_CCER_CC3E; // enable ch 3
	TIM3->CCER  |= TIM_CCER_CC4E; // enable ch 4

	NVIC_SetPriority(TIM2_IRQn, STEP_PRIORITY);
	NVIC_EnableIRQ(TIM2_IRQn);

	TIM2->CR1 |= TIM_CR1_CEN; // enable timers
	TIM3->CR1 |= TIM_CR1_CEN;
}

/*
 *	initialize PWM output pins
 */
void output_init(void) {
	RCC->AHBENR  |= RCC_AHBENR_GPIOCEN;

	gpio_output_init(GPIOC, X_DIR); // PC0 (x-axis dir)
	gpio_output_init(GPIOC, Y_DIR); // PC1 (y-axis dir)

	gpio_output_init(GPIOC, X_SLEEP); // PC6 (x-axis sleep)
	gpio_output_init(GPIOC, Y_SLEEP); // PC7 (y-axis sleep)

	// wire PWM to LED to verify output (use PC8 or PC9 to capture PWM output)
	gpio_alternate_init(GPIOC, X_STEP); // PC8 (x-axis step)
	GPIOC->AFR[1] &= ~(GPIO_AFRH_AFRH0);
	gpio_alternate_init(GPIOC, Y_STEP); // PC9 (y-axis step)
	GPIOC->AFR[1] &= ~(GPIO_AFRH_AFRH1);
}

/*
 *	initialize calibration switches and
 *  set up EXTI interrupts
 */
void cal_switches_init(void) {
	RCC->AHBENR  |= RCC_AHBENR_GPIOCEN;

	gpio_output_init(GPIOC, X_RESET); // PC2 (x-axis reset)
	gpio_output_init(GPIOC, Y_RESET); // PC3 (y-axis reset)

	gpio_input_init(GPIOC, X_CAL);
	gpio_input_init(GPIOC, Y_CAL);

	// resets internal step counters in DRV8824
	gpio_write_reg16(&(GPIOC->ODR), X_RESET, 1); // nRESET
	gpio_write_reg16(&(GPIOC->ODR), Y_RESET, 1);
}

void sys_init(){
	RCC->APB2ENR |= RCC_APB2ENR_ADCEN;
	RCC->AHBENR |= RCC_AHBENR_GPIOCEN;//enable clock for gpioc - analog in
	//PB10 -ADC PB15 are used for data select lines for MUX
	RCC->AHBENR |= RCC_AHBENR_GPIOBEN;
	RCC->APB2ENR |= RCC_APB2ENR_USART1EN;

	//configure GPIO 10 - 15 to general purpose output mode
	gpio_output_init(GPIOB, MAGNET_PIN); // PB2
	GPIOB->MODER |= GPIO_MODER_MODER10_0 | GPIO_MODER_MODER11_0;
	GPIOB->MODER |= GPIO_MODER_MODER12_0 | GPIO_MODER_MODER13_0;
	GPIOB->MODER |= GPIO_MODER_MODER14_0 | GPIO_MODER_MODER15_0;

	//enable alternate function mode for USART, with pull up resistor and open drain
	GPIOB->MODER |= GPIO_MODER_MODER6_1 | GPIO_MODER_MODER7_1;
	GPIOB->OTYPER |= GPIO_OTYPER_OT_6;
	GPIOB->PUPDR |= GPIO_PUPDR_PUPDR6_0;

	//enable clock for ADC
	ADC1->CFGR1 |= ADC_CFGR1_CONT;
	//ADC1->CFGR1 &= ~ADC_CFGR1_CONT; // enable single conversion
	ADC1->CHSELR |= ADC_CHSELR_CHSEL10; //PC0 is hooked to channel 10
	//calibrate ADC
	if((ADC1->CR & ADC_CR_ADEN) != 0){ //disable ADC if needed
		ADC1->CR |= ADC_CR_ADDIS;
	}
	while((ADC1->CR & ADC_CR_ADEN) != 0){
		/*implement a time-out here*/
	}
	ADC1->CR |= ADC_CR_ADCAL;
	while((ADC1->CR & ADC_CR_ADCAL) != 0){
		/*implement a time-out here*/
	}
	/*Enable sequence code*/
	if((ADC1->ISR & ADC_ISR_ADRDY) != 0){
		ADC1->ISR |= ADC_ISR_ADRDY;
	}
	ADC1->CR |= ADC_CR_ADEN;
	while((ADC1->ISR & ADC_ISR_ADRDY) == 0){
		/*implement a time out here*/
	}

	// setup uart
	GPIOA->MODER  |= (2 << GPIO_MODER_MODER9_Pos);  // alternate
	GPIOA->MODER  |= (2 << GPIO_MODER_MODER10_Pos); // alternate
	GPIOA->AFR[1] |= (1 << GPIO_AFRH_AFRH1_Pos); // PA9,  USART1_TX
	GPIOA->AFR[1] |= (1 << GPIO_AFRH_AFRH2_Pos); // PA10, USART1_RX
	USART1->BRR    = 833; // set baud to 9600 = 8MHz/69
	USART1->CR1   |= USART_CR1_TE; // enable TX
	USART1->CR1   |= USART_CR1_RE; // enable RX

	USART1->CR1   |= USART_CR1_UE; // enable USART1
}

/* USER CODE END 0 */

int main(void)
{

  /* USER CODE BEGIN 1 */
  // LEDS on PC8, PC9, PC6, PC7 DON'T USE THESE PINS FOR TIMERS
  // Use TIM2_CH2 (PA1) and TIM3_CH4 (PB1)
  /* USER CODE END 1 */

  /* MCU Configuration----------------------------------------------------------*/

  /* Reset of all peripherals, Initializes the Flash interface and the Systick. */
  HAL_Init();

  /* Configure the system clock */
  SystemClock_Config();

  /* Initialize all configured peripherals */

  /* USER CODE BEGIN 2 */
  button_init();
  timer_init();
  output_init();
  cal_switches_init();
  sys_init();

  // move magnet so biases are correct
  calibrate();

  init_board();

  rx_char();

  //LOG_INFO("system ready, place pieces");
  /* USER CODE END 2 */

  /* Infinite loop */
  while (1)
  {

  /* USER CODE BEGIN 3 */
	//__WFI();
	  wait_for_command();

  }
  /* USER CODE END 3 */

}

/** System Clock Configuration
*/
void SystemClock_Config(void)
{

  RCC_OscInitTypeDef RCC_OscInitStruct;
  RCC_ClkInitTypeDef RCC_ClkInitStruct;

    /**Initializes the CPU, AHB and APB busses clocks
    */
  RCC_OscInitStruct.OscillatorType = RCC_OSCILLATORTYPE_HSI;
  RCC_OscInitStruct.HSIState = RCC_HSI_ON;
  RCC_OscInitStruct.HSICalibrationValue = 16;
  RCC_OscInitStruct.PLL.PLLState = RCC_PLL_NONE;
  if (HAL_RCC_OscConfig(&RCC_OscInitStruct) != HAL_OK)
  {
    Error_Handler();
  }

    /**Initializes the CPU, AHB and APB busses clocks
    */
  RCC_ClkInitStruct.ClockType = RCC_CLOCKTYPE_HCLK|RCC_CLOCKTYPE_SYSCLK
                              |RCC_CLOCKTYPE_PCLK1;
  RCC_ClkInitStruct.SYSCLKSource = RCC_SYSCLKSOURCE_HSI;
  RCC_ClkInitStruct.AHBCLKDivider = RCC_SYSCLK_DIV1;
  RCC_ClkInitStruct.APB1CLKDivider = RCC_HCLK_DIV1;

  if (HAL_RCC_ClockConfig(&RCC_ClkInitStruct, FLASH_LATENCY_0) != HAL_OK)
  {
    Error_Handler();
  }

    /**Configure the Systick interrupt time
    */
  HAL_SYSTICK_Config(HAL_RCC_GetHCLKFreq()/1000);

    /**Configure the Systick
    */
  HAL_SYSTICK_CLKSourceConfig(SYSTICK_CLKSOURCE_HCLK);

  /* SysTick_IRQn interrupt configuration */
  HAL_NVIC_SetPriority(SysTick_IRQn, 0, 0);
}

void Error_Handler(void)
{
  while(1)
  {
  }
}

/************************ (C) COPYRIGHT STMicroelectronics *****END OF FILE****/
